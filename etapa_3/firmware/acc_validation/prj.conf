## CMakeLists.txt
```
cmake_minimum_required(VERSION 3.20.0)

# Modulo compartilhado do SysCare (bindings, HAL, drivers, servicos)
list(APPEND ZEPHYR_EXTRA_MODULES ${CMAKE_CURRENT_SOURCE_DIR}/../lib)

find_package(Zephyr REQUIRED HINTS $ENV{ZEPHYR_BASE})

project(acc_validation)

target_sources(app PRIVATE src/main.c)
```

## prj.conf
```kconfig
# SysCare - acc_validation: validacao do acelerometro IIM-42351

# Console na USB (CDC ACM)
CONFIG_CONSOLE=y
CONFIG_UART_CONSOLE=y
# Permite ao app esperar o terminal abrir (DTR) antes de imprimir
CONFIG_UART_LINE_CTRL=y

# Alimentacao do acelerometro (regulator-fixed no app.overlay).
# Os reguladores precisam iniciar ANTES do SPI (prioridade 50): o driver
# SPI coloca o CS em nivel alto no init e alimentaria o sensor desligado.
CONFIG_REGULATOR=y
CONFIG_REGULATOR_FIXED_INIT_PRIORITY=45

# Acelerometro
CONFIG_SPI=y
CONFIG_GPIO=y

# Logs no modo deferred (padrao). O printk passa pelo log, entao a ordem
# entre printk e LOG_* se mantem. Nao usar CONFIG_LOG_MODE_IMMEDIATE: com
# o console na USB a placa nao enumera (Windows: erro 43, falha no
# descritor). Testado em 25/10: imediato falha, deferred funciona.
CONFIG_LOG=y
# Folga para despejar o CSV da captura (padrao: 1 KB)
CONFIG_LOG_BUFFER_SIZE=4096

# Pilhas com folga para a formatacao dos printk (2 KB, como no app BLE)
CONFIG_MAIN_STACK_SIZE=2048
CONFIG_SYSTEM_WORKQUEUE_STACK_SIZE=2048
```

## app.overlay
```dts
/*
 * SysCare - acc_validation: overlay do devicetree para a XIAO nRF52840
 *
 * A pinagem e a alimentacao do acelerometro ficam no modulo lib/,
 * compartilhadas com o firmware integrado (etapa_3/firmware).
 */

#include <syscare/iim42351_xiao.dtsi>
```

## src/main.c
```c
/*
 * SysCare - acc_validation: validacao do acelerometro IIM-42351
 * XIAO nRF52840 / Zephyr / NCS 3.4.1
 *
 * Projeto so com o acelerometro; os componentes reutilizaveis
 * (bindings, HAL, driver, servico) ficam no modulo ../lib.
 *
 * Fase 5: deteccao de queda livre
 *   1. Espera o terminal abrir na USB, para os logs do init aparecerem
 *   2. Liga a deteccao de queda livre e mostra os parametros aplicados
 *   3. A cada queda, mostra a duracao e a altura estimada
 *
 * Teste: soltar a placa sobre uma almofada de alturas conhecidas
 * (20 cm, 50 cm, 1 m) e comparar; sacudir, balancar o braco e bater na
 * mesa nao devem gerar eventos.
 */

#include <errno.h>
#include <stdint.h>

#include <zephyr/device.h>
#include <zephyr/devicetree.h>
#include <zephyr/drivers/uart.h>
#include <zephyr/kernel.h>
#include <zephyr/sys/printk.h>

#include "srv_accelerometer.h"

#define STATUS_PERIOD   K_SECONDS(10)

/* Eventos vindos do callback (workqueue do sistema) para o main */
K_MSGQ_DEFINE(event_q, sizeof(acc_event_t), 8, 4);

static void on_acc_event(const acc_event_t *evt)
{
    (void)k_msgq_put(&event_q, evt, K_NO_WAIT);
}

/*
 * O console e USB (CDC ACM): o que e enviado antes de o terminal abrir
 * se perde. Espera o terminal sinalizar DTR (a maioria faz isso ao abrir
 * a porta).
 */
static void wait_for_terminal(void)
{
    const struct device *console = DEVICE_DT_GET(DT_CHOSEN(zephyr_console));
    uint32_t dtr = 0;

    if (!device_is_ready(console)) {
        return;
    }

    while (!dtr) {
        if (uart_line_ctrl_get(console, UART_LINE_CTRL_DTR, &dtr) != 0) {
            return;     /* console sem controle de linha: segue sem esperar */
        }
        k_msleep(100);
    }
}

int main(void)
{
    acc_freefall_config_t ff = {
        .lowg_mg = 500,
        .highg_mg = 3000,
        .min_height_cm = 13,
        .max_height_cm = 201,
        .debounce_ms = 1000,
    };
    acc_event_t evt;
    uint32_t falls = 0;
    int err;

    wait_for_terminal();

    printk("\n");
    printk("=================================\n");
    printk("  SysCare - acc_validation\n");
    printk("  Fase 5: queda livre\n");
    printk("=================================\n");

    err = srv_accelerometer_init(on_acc_event);
    if (err) {
        while (1) {
            printk("srv_accelerometer_init: erro %d (ver o log acima)\n", err);
            k_sleep(STATUS_PERIOD);
        }
    }

    printk("Pedido:   low-g %u mg, high-g %u mg, %u a %u cm, debounce %u ms\n",
           ff.lowg_mg, ff.highg_mg, ff.min_height_cm, ff.max_height_cm, ff.debounce_ms);

    err = srv_accelerometer_freefall_enable(&ff);
    if (err) {
        while (1) {
            printk("srv_accelerometer_freefall_enable: erro %d\n", err);
            k_sleep(STATUS_PERIOD);
        }
    }

    printk("Aplicado: low-g %u mg, high-g %u mg, %u a %u cm, debounce %u ms\n",
           ff.lowg_mg, ff.highg_mg, ff.min_height_cm, ff.max_height_cm, ff.debounce_ms);
    printk("Aguardando quedas...\n");

    while (1) {
        if (k_msgq_get(&event_q, &evt, STATUS_PERIOD) != 0) {
            printk("(aguardando quedas; %u detectadas ate agora)\n", (unsigned int)falls);
            continue;
        }

        if (evt.type == ACC_EVENT_FREEFALL) {
            falls++;
            printk(">>> QUEDA LIVRE #%u: duracao %u ms, altura estimada ~%u cm\n",
                   (unsigned int)falls, evt.duration_ms, evt.height_cm);
        }
    }

    return 0;
}
```
