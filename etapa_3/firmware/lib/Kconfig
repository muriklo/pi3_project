## etapa_3/firmware/lib/drivers/iim42351/Kconfig
```kconfig
# SysCare - driver do acelerometro IIM-42351

menuconfig SYSCARE_IIM42351
	bool "Driver do acelerometro IIM-42351"
	default y
	depends on DT_HAS_INVENSENSE_IIM42351_ENABLED
	select SYSCARE_HAL_SPI
	select REGULATOR if $(dt_compat_any_has_prop,$(DT_COMPAT_INVENSENSE_IIM42351),vdd-supply)
	select REGULATOR if $(dt_compat_any_has_prop,$(DT_COMPAT_INVENSENSE_IIM42351),vddio-supply)
	help
	  Driver proprio do SysCare para o acelerometro IIM-42351 (SPI).
	  E habilitado automaticamente quando o devicetree tem um no com
	  compatible "invensense,iim42351" e status "okay".

if SYSCARE_IIM42351

config SYSCARE_IIM42351_TRIGGER
	bool "Interrupcoes do sensor (INT1/INT2)"
	default y
	depends on $(dt_compat_any_has_prop,$(DT_COMPAT_INVENSENSE_IIM42351),int1-gpios) || \
		   $(dt_compat_any_has_prop,$(DT_COMPAT_INVENSENSE_IIM42351),int2-gpios)
	select SYSCARE_HAL_GPIO
	help
	  Usa os pinos int1-gpios/int2-gpios do devicetree. O watermark da
	  FIFO vai para o INT2 se ele existir, senao para o INT1. Sem
	  nenhum pino, a FIFO e lida por polling.

module = SYSCARE_IIM42351
module-str = iim42351
source "subsys/logging/Kconfig.template.log_config"

endif # SYSCARE_IIM42351
```

## etapa_3/firmware/lib/dts/bindings/invensense,iim42351.yaml
```yaml
# SysCare - binding do acelerometro IIM-42351
#
# Baseado em zephyr/dts/bindings/sensor/invensense,icm42605.yaml
# (Copyright (c) 2020 TDK Invensense, SPDX-License-Identifier: Apache-2.0).
#
# Diferencas em relacao ao ICM-42605:
#   - compatible proprio: o mapa de registradores e outro, e o driver do
#     Zephyr para o ICM-42605 nao deve assumir este chip;
#   - sem giroscopio (gyro-hz e gyro-fs removidos);
#   - int-gpios (obrigatorio) virou int1-gpios e int2-gpios (opcionais);
#   - novos: accel-mode, vdd-supply e vddio-supply.

description: |
  IIM-42351 - acelerometro de 3 eixos da TDK InvenSense, ligado por SPI.
  Usado pelo driver proprio do SysCare (drivers/iim42351), nao pelo
  subsistema de sensores do Zephyr.

compatible: "invensense,iim42351"

include: [sensor-device.yaml, spi-device.yaml]

properties:
  int1-gpios:
    type: phandle-array
    description: |
      Pino INT1 do sensor: eventos do APEX (queda livre).
      O sensor e configurado como push-pull, ativo alto.
      Opcional: sem ele o driver nao gera eventos de queda.

  int2-gpios:
    type: phandle-array
    description: |
      Pino INT2 do sensor: watermark da FIFO.
      O sensor e configurado como push-pull, ativo alto.
      Opcional: sem ele a FIFO e lida por polling.

  vdd-supply:
    type: phandle
    description: |
      Regulador que alimenta o VDD do sensor.
      Opcional: sem ele o driver assume alimentacao fixa.

  vddio-supply:
    type: phandle
    description: |
      Regulador que alimenta o VDDIO do sensor.
      Opcional: sem ele o driver assume alimentacao fixa.

  accel-hz:
    type: int
    default: 100
    description: |
      ODR inicial do acelerometro (Hz).
      Mapeia no campo ACCEL_ODR do registrador ACCEL_CONFIG0.
      1, 3, 6 e 12 representam 1,5625, 3,125, 6,25 e 12,5 Hz.
    enum:
      - 1
      - 3
      - 6
      - 12
      - 25
      - 50
      - 100
      - 200
      - 500
      - 1000
      - 2000
      - 4000
      - 8000

  accel-fs:
    type: int
    default: 16
    description: |
      Fundo de escala inicial do acelerometro (g).
      O indice no enum e o codigo do campo ACCEL_FS_SEL do ACCEL_CONFIG0
      (16 g -> 0, 8 g -> 1, 4 g -> 2, 2 g -> 3).
    enum:
      - 16
      - 8
      - 4
      - 2

  accel-mode:
    type: string
    default: "low-noise"
    description: |
      Modo inicial do acelerometro (campo ACCEL_MODE do PWR_MGMT0).
    enum:
      - "low-noise"
      - "low-power"
```

## etapa_3/firmware/lib/services/Kconfig
```kconfig
# SysCare - servicos

config SYSCARE_SRV_ACCELEROMETER
	bool "Servico do acelerometro"
	default y
	depends on SYSCARE_IIM42351
	help
	  API generica do acelerometro (srv_accelerometer_*), que chama o
	  driver do modelo habilitado. Para outro modelo: acrescentar o driver
	  aqui no "depends on" e a tabela dele no srv_accelerometer.c.
```
